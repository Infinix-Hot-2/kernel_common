## Documentation/devicetree/bindings/trusty/trusty-timer.txt
```
Trusty backup timer interface

On some platforms Trusty might require additional non-secure timer to properly
implement deep cpu idle states. Typically, it for platforms that might loose
the state of local timer.

Required properties:
- compatible: "android,trusty-timer-v1"

Must be a child of the node that provides the trusty std/fast call interface.
```

## drivers/video/adf/Kconfig
```kconfig
menuconfig ADF
	depends on SW_SYNC
	depends on DMA_SHARED_BUFFER
	tristate "Atomic Display Framework"
```
